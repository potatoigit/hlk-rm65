## package/mtk/drivers/mt7915/config.in
```kconfig
if PACKAGE_kmod-mt7915

config MTK_MT7915_SUPPORT_OPENWRT
	bool
	default y
	depends on PACKAGE_kmod-mt7915

config MTK_MT7915_WIFI_DRIVER
	bool
	default y
	depends on PACKAGE_kmod-mt7915
	select MTK_MT7915_WIFI_MT_MAC
	select MTK_MT7915_MT_MAC
	#select MTK_MT7915_FIRST_IF_MT7615E
	#select MTK_MT7915_CHIP_MT7622
	#select MTK_MT7915_CHIP_MT7626
	#select MTK_MT7915_SECOND_IF_MT7615E
	#select MTK_MT7915_THIRD_IF_MT7615E
	#select MTK_MT7915_CHIP_MT7615E

if MTK_MT7915_WIFI_DRIVER

choice
	prompt "Choose First WiFi Interface"
	config MTK_MT7915_FIRST_IF_NONE
	bool "None"

	config MTK_MT7915_FIRST_IF_MT7615E
	bool "MT7615E"
	select MTK_MT7915_WIFI_MT_MAC
	select MTK_MT7915_MT_MAC
	select MTK_MT7915_CHIP_MT7615E

	config MTK_MT7915_FIRST_IF_MT7622
	bool "MT7622"
	select MTK_MT7915_WIFI_MT_MAC
	select MTK_MT7915_MT_MAC
	select MTK_MT7915_CHIP_MT7622

	config MTK_MT7915_FIRST_IF_MT7626
	bool "MT7626"
	select MTK_MT7915_WIFI_MT_MAC
	select MTK_MT7915_MT_MAC
	select MTK_MT7915_CHIP_MT7626

	config MTK_MT7915_FIRST_IF_AXE
        bool "MT6867"
        select MTK_MT7915_WIFI_MT_MAC
        select MTK_MT7915_MT_MAC
        select MTK_MT7915_CHIP_AXE

	config MTK_MT7915_FIRST_IF_MT7915
        bool "MT7915"
        select MTK_MT7915_WIFI_MT_MAC
        select MTK_MT7915_MT_MAC
        select MTK_MT7915_CHIP_MT7915

	config MTK_MT7915_FIRST_IF_MT7916
        bool "MT7916"
        select MTK_MT7915_WIFI_MT_MAC
        select MTK_MT7915_MT_MAC
        select MTK_MT7915_CHIP_MT7916

endchoice

choice
	prompt "Choose Second WiFi Interface"
	config MTK_MT7915_SECOND_IF_NONE
	bool "None"

	config MTK_MT7915_SECOND_IF_MT7615E
	bool "MT7615E"
	select MTK_MT7915_WIFI_MT_MAC
	select MTK_MT7915_CHIP_MT7615E
	select MTK_MT7915_MULTI_INF_SUPPORT

	config MTK_MT7915_SECOND_IF_AXE
	bool "MT6867"
	select MTK_MT7915_WIFI_MT_MAC
	select MTK_MT7915_MT_MAC
	select MTK_MT7915_CHIP_AXE

	config MTK_MT7915_SECOND_IF_MT7915
        bool "MT7915"
        select MTK_MT7915_WIFI_MT_MAC
        select MTK_MT7915_MT_MAC
        select MTK_MT7915_CHIP_MT7915

	config MTK_MT7915_SECOND_IF_MT7916
        bool "MT7916"
        select MTK_MT7915_WIFI_MT_MAC
        select MTK_MT7915_MT_MAC
        select MTK_MT7915_CHIP_MT7916

endchoice

choice
	prompt "Choose Third WiFi Interface"
	config MTK_MT7915_THIRD_IF_NONE
	bool "None"

	config MTK_MT7915_THIRD_IF_MT7615E
	bool "MT7615E"
	select MTK_MT7915_WIFI_MT_MAC
	select MTK_MT7915_CHIP_MT7615E
	select MTK_MT7915_MULTI_INF_SUPPORT

	config MTK_MT7915_THIRD_IF_MT7915
        bool "MT7915"
        select MTK_MT7915_WIFI_MT_MAC
        select MTK_MT7915_MT_MAC
        select MTK_MT7915_CHIP_MT7915
	select MTK_MT7915_MULTI_INF_SUPPORT

	config MTK_MT7915_THIRD_IF_MT7916
        bool "MT7916"
        select MTK_MT7915_WIFI_MT_MAC
        select MTK_MT7915_MT_MAC
        select MTK_MT7915_CHIP_MT7916
        select MTK_MT7915_MULTI_INF_SUPPORT

endchoice

config  MTK_MT7915_RT_FIRST_CARD
        int
        depends on ! MTK_MT7915_FIRST_IF_NONE
	default 7615 if MTK_MT7915_FIRST_IF_MT7615E
        default 7622 if MTK_MT7915_FIRST_IF_MT7622
        default 7626 if MTK_MT7915_FIRST_IF_MT7626
        default 6867 if MTK_MT7915_FIRST_IF_AXE

config  MTK_MT7915_RT_SECOND_CARD
        int
        depends on ! MTK_MT7915_SECOND_IF_NONE
        default 7615 if MTK_MT7915_SECOND_IF_MT7615E
        default 6867 if MTK_MT7915_SECOND_IF_AXE

config  MTK_MT7915_RT_THIRD_CARD
        int
        depends on ! MTK_MT7915_THIRD_IF_NONE
        default 7615 if MTK_MT7915_THIRD_IF_MT7615E

config  MTK_MT7915_RT_FIRST_IF_RF_OFFSET
        hex
        depends on ! MTK_MT7915_FIRST_IF_NONE
        default 0xc0000

config  MTK_MT7915_RT_SECOND_IF_RF_OFFSET
        hex
        depends on ! MTK_MT7915_SECOND_IF_NONE
        default 0xc8000

config  MTK_MT7915_RT_THIRD_IF_RF_OFFSET
        hex
        depends on ! MTK_MT7915_THIRD_IF_NONE
        default 0xd0000

config MTK_MT7915_MT_WIFI
	tristate "MT MT7915 WIFI Driver"
	select MTK_MT7915_WIFI_BASIC_FUNC if MTK_MT7915_MT_WIFI

config MTK_MT7915_MT_WIFI_PATH
	string
	depends on MTK_MT7915_MT_WIFI
	default "mt7915"

if MTK_MT7915_MT_WIFI
menu "WiFi Generic Feature Options"
choice
	prompt "EEPROM Type of 1st Card"
	depends on ! MTK_MT7915_FIRST_IF_NONE

	config MTK_MT7915_FIRST_IF_EEPROM_FLASH
	bool "FLASH"
	
	config MTK_MT7915_FIRST_IF_EEPROM_PROM
	bool "EEPROM"

	config MTK_MT7915_FIRST_IF_EEPROM_EFUSE
	bool "EFUSE"

endchoice

config MTK_MT7915_RT_FIRST_CARD_EEPROM
	string
	depends on ! MTK_MT7915_FIRST_IF_NONE
	default "prom" if MTK_MT7915_FIRST_IF_EEPROM_PROM
	default "efuse" if MTK_MT7915_FIRST_IF_EEPROM_EFUSE
	default "flash" if MTK_MT7915_FIRST_IF_EEPROM_FLASH

choice
	prompt "EEPROM Type of 2nd Card"
	depends on ! MTK_MT7915_SECOND_IF_NONE

	config MTK_MT7915_SECOND_IF_EEPROM_FLASH
	bool "FLASH"

	config MTK_MT7915_SECOND_IF_EEPROM_PROM
	bool "EEPROM"

	config MTK_MT7915_SECOND_IF_EEPROM_EFUSE
	bool "EFUSE"

endchoice

config MTK_MT7915_RT_SECOND_CARD_EEPROM
	string
	depends on ! MTK_MT7915_SECOND_IF_NONE
	default "prom" if MTK_MT7915_SECOND_IF_EEPROM_PROM
	default "efuse" if MTK_MT7915_SECOND_IF_EEPROM_EFUSE
	default "flash" if MTK_MT7915_SECOND_IF_EEPROM_FLASH

choice
		prompt "EEPROM Type of 3th Card"
		depends on ! MTK_MT7915_THIRD_IF_NONE

		config MTK_MT7915_THIRD_IF_EEPROM_FLASH
		bool "FLASH"

		config MTK_MT7915_THIRD_IF_EEPROM_PROM
		bool "EEPROM"

		config MTK_MT7915_THIRD_IF_EEPROM_EFUSE
		bool "EFUSE"

endchoice

config MTK_MT7915_RT_THIRD_CARD_EEPROM
		string
		depends on ! MTK_MT7915_THIRD_IF_NONE
		default "prom" if MTK_MT7915_THIRD_IF_EEPROM_PROM
		default "efuse" if MTK_MT7915_THIRD_IF_EEPROM_EFUSE
		default "flash" if MTK_MT7915_THIRD_IF_EEPROM_FLASH
	
config MTK_MT7915_MULTI_INF_SUPPORT
	bool
	default y if !MTK_MT7915_FIRST_IF_NONE && !MTK_MT7915_SECOND_IF_NONE

config MTK_MT7915_MT76XX_COMBO_DUAL_DRIVER_SUPPORT
        bool "MT76XX Combo Dual Driver support"
        default n

config MTK_MT7915_WIFI_BASIC_FUNC
	bool "Basic Functions"
	select MTK_MT7915_WIRELESS_EXT
	select MTK_MT7915_WEXT_SPY
	select MTK_MT7915_WEXT_PRIV

config MTK_MT7915_DOT11_N_SUPPORT
	bool "802.11n support"
	default y

config MTK_MT7915_DOT11_VHT_AC
	bool "802.11AC support"
	depends on MTK_MT7915_WIFI_DRIVER
	depends on MTK_MT7915_DOT11_N_SUPPORT
	default y

config MTK_MT7915_DOT11_HE_AX
	bool "802.11AX support"
	depends on MTK_MT7915_WIFI_DRIVER
	depends on MTK_MT7915_DOT11_VHT_AC
	depends on MTK_MT7915_CHIP_AXE || MTK_MT7915_CHIP_MT7915 || MTK_MT7915_CHIP_MT7916
	default y

config MTK_MT7915_CFG_SUPPORT_FALCON_MURU
	bool "MURU support"
	depends on MTK_MT7915_WIFI_DRIVER
	depends on MTK_MT7915_DOT11_VHT_AC
	depends on MTK_MT7915_CHIP_AXE || MTK_MT7915_CHIP_MT7915 || MTK_MT7915_CHIP_MT7916
	default y

config MTK_MT7915_CFG_SUPPORT_FALCON_TXCMD_DBG
	bool "TXCMD DBG support"
	depends on MTK_MT7915_WIFI_DRIVER
	depends on MTK_MT7915_DOT11_VHT_AC
	depends on MTK_MT7915_CHIP_AXE || MTK_MT7915_CHIP_MT7915 || MTK_MT7915_CHIP_MT7916
	default y

config MTK_MT7915_CFG_SUPPORT_FALCON_SR
	bool "SR(Spatial Reuse) support"
	depends on MTK_MT7915_WIFI_DRIVER
	depends on MTK_MT7915_CHIP_MT7915 || MTK_MT7915_CHIP_MT7916
	default y

config MTK_MT7915_CFG_SUPPORT_FALCON_PP
	bool "PP(Preamble Puncture) support"
	depends on MTK_MT7915_WIFI_DRIVER
	depends on MTK_MT7915_CHIP_MT7915 || MTK_MT7915_CHIP_MT7916
	default y

config MTK_MT7915_WIFI_TWT_SUPPORT
	bool "TWT(Target Wake Time) support"
	depends on MTK_MT7915_WIFI_DRIVER
	depends on MTK_MT7915_DOT11_HE_AX
	depends on MTK_MT7915_CHIP_AXE || MTK_MT7915_CHIP_MT7915 || MTK_MT7915_CHIP_MT7916
	default y

config MTK_MT7915_G_BAND_256QAM_SUPPORT
	bool "2.4G 256QAM support"
	depends on MTK_MT7915_WIFI_DRIVER
	depends on MTK_MT7915_DOT11_VHT_AC
        default y

config MTK_MT7915_BRCM_256QAM_SUPPORT
	bool "BRCM 2.4G 256QAM support"
	depends on MTK_MT7915_WIFI_DRIVER
	depends on MTK_MT7915_G_BAND_256QAM_SUPPORT
	default n

config MTK_MT7915_VHT_TXBF_2G_EPIGRAM_IE_SUPPORT
    bool "BRCM 2.4G VHT Sounding support"
	depends on MTK_MT7915_WIFI_DRIVER
	default n
		
config MTK_MT7915_TPC_SUPPORT
	bool "802.11h TPC Support"
	depends on MTK_MT7915_WIFI_DRIVER
	default y

config MTK_MT7915_ICAP_SUPPORT
	bool "ICAP Support"
	depends on MTK_MT7915_WIFI_DRIVER
	depends on MTK_MT7915_MT_AP_SUPPORT
	default y

config MTK_MT7915_SPECTRUM_SUPPORT
	bool "Wifi Spectrum Support"
	depends on MTK_MT7915_WIFI_DRIVER
	depends on MTK_MT7915_MT_AP_SUPPORT
	default y

config MTK_MT7915_BACKGROUND_SCAN_SUPPORT
	bool "Background Scan Support"
	depends on MTK_MT7915_WIFI_DRIVER
	default y

config MTK_MT7915_SMART_CARRIER_SENSE_SUPPORT
	bool "Smart Carrier Sense Support"
	depends on MTK_MT7915_WIFI_DRIVER
	default y

config MTK_MT7915_THERMAL_PROTECT_SUPPORT
        bool "THERMAL PROTECT SUPPORT"
        depends on MTK_MT7915_WIFI_DRIVER && MTK_MT7915_SMART_CARRIER_SENSE_SUPPORT
        default n

config MTK_MT7915_SCS_FW_OFFLOAD
        bool "SCS FW OFFLOAD Support"
        depends on MTK_MT7915_WIFI_DRIVER && MTK_MT7915_SMART_CARRIER_SENSE_SUPPORT
        default n

config MTK_MT7915_MT_DFS_SUPPORT
	bool "Dynamic Frequency Selection Support"
	depends on MTK_MT7915_WIFI_DRIVER
	default y
	
config MTK_MT7915_OFFCHANNEL_SCAN_FEATURE
	bool "Channel Quality Monitor"
	depends on MTK_MT7915_WIFI_DRIVER
	depends on MTK_MT7915_MT_AP_SUPPORT
	default n

#config MTK_MT7915_WFA_VHT_R2_PF
#	bool "WFA VHT R2 Plugfest"
#	depends on MTK_MT7915_DOT11_VHT_AC
#	default n

config MTK_MT7915_HDR_TRANS_TX_SUPPORT
	bool "Tx Header Translation"
	depends on MTK_MT7915_CHIP_MT7615E || MTK_MT7915_CHIP_MT7622 || MTK_MT7915_CHIP_MT7626 || MTK_MT7915_CHIP_AXE || MTK_MT7915_CHIP_MT7915 || MTK_MT7915_CHIP_MT7916
	default y

config MTK_MT7915_HDR_TRANS_RX_SUPPORT
	bool "Rx Header Translation"
	depends on MTK_MT7915_CHIP_MT7615E || MTK_MT7915_CHIP_MT7622 || MTK_MT7915_CHIP_MT7626 || MTK_MT7915_CHIP_AXE || MTK_MT7915_CHIP_MT7915 || MTK_MT7915_CHIP_MT7916
	default y

config MTK_MT7915_DBDC_MODE
	bool "dbdc mode support"
	depends on MTK_MT7915_CHIP_MT7615E || MTK_MT7915_CHIP_MT7626 || MTK_MT7915_CHIP_MT7915 || MTK_MT7915_CHIP_MT7916
	select MTK_MT7915_MULTI_PROFILE_SUPPORT
#	select MTK_MT7915_DEFAULT_5G_PROFILE
	default y

config MTK_MT7915_MULTI_PROFILE_SUPPORT
        bool "Multi Profile Support"
        depends on MTK_MT7915_DBDC_MODE
        default y

config MTK_MT7915_DEFAULT_5G_PROFILE
	bool "5G default profile for DBDC"
	depends on MTK_MT7915_DBDC_MODE
#	depends on MTK_MT7915_MULTI_PROFILE_SUPPORT
	default y

config MTK_MT7915_WSC_INCLUDED
	bool "WSC (WiFi Simple Config)"
	depends on MTK_MT7915_WIFI_DRIVER
	depends on MTK_MT7915_MT_AP_SUPPORT || MTK_MT7915_MT_STA_SUPPORT
	default y

config MTK_MT7915_WSC_V2_SUPPORT
	bool "WSC V2(WiFi Simple Config Version 2.0)"
	depends on MTK_MT7915_WIFI_DRIVER
	depends on MTK_MT7915_MT_AP_SUPPORT || MTK_MT7915_MT_STA_SUPPORT
	default y

config MTK_MT7915_DOT11W_PMF_SUPPORT
	bool "PMF"
	depends on MTK_MT7915_WIFI_DRIVER
	depends on MTK_MT7915_MT_AP_SUPPORT || MTK_MT7915_MT_STA_SUPPORT
	default y

config MTK_MT7915_TXBF_SUPPORT
	bool "Tx Bean Forming Support"
	depends on MTK_MT7915_WIFI_DRIVER
	default y

config MTK_MT7915_FAST_NAT_SUPPORT
       bool "Fast-NAT support"
#      depends on RA_HW_NAT_WIFI
       default n

config MTK_MT7915_WHNAT_SUPPORT
	tristate "Wifi Hardware NAT support"
	depends on MTK_MT7915_CHIP_MT7615E || MTK_MT7915_CHIP_MT7915 || MTK_MT7915_CHIP_MT7916
	depends on MTK_MT7915_WLAN_HOOK
	depends on MTK_MT7915_FAST_NAT_SUPPORT
	depends on PACKAGE_kmod-hw_nat || PACKAGE_kmod-mediatek_hnat
	default n

config MTK_MT7915_WARP_V2
	bool "Warp driver version 2 support"
	depends on PACKAGE_kmod-warp && MTK_MT7915_WHNAT_SUPPORT
	default n

#config MTK_MT7915_LLTD_SUPPORT
#	bool "LLTD (Link Layer Topology Discovery Protocol)"
#	depends on MTK_MT7915_WIFI_DRIVER
#	depends on MTK_MT7915_MT_AP_SUPPORT
#	default n

#config MTK_MT7915_QOS_DLS_SUPPORT
#	bool "802.11e DLS ((Direct-Link Setup) Support"
#	depends on MTK_MT7915_WIFI_DRIVER
#	depends on MTK_MT7915_MT_AP_SUPPORT
#	default n

#config MTK_MT7915_WAPI_SUPPORT
#	bool "WAPI Support"
#	depends on MTK_MT7915_WIFI_DRIVER
#	default n

config MTK_MT7915_FTM_SUPPORT
	bool "FTM Support"
	depends on MTK_MT7915_WIFI_DRIVER
	select MTK_MT7915_PASSPOINT_R2
	default n

#config MTK_MT7915_CARRIER_DETECTION_SUPPORT
#	bool "Carrier Detect"
#	depends on MTK_MT7915_WIFI_DRIVER
#	default n

config MTK_MT7915_IGMP_SNOOP_SUPPORT
	bool "IGMP snooping"
	depends on MTK_MT7915_WIFI_DRIVER
	depends on MTK_MT7915_MT_AP_SUPPORT
	default y

config MTK_MT7915_SNIFFER_RADIOTAP_SUPPORT
	bool "snifferbox support"
	depends on MTK_MT7915_CHIP_MT7915 || MTK_MT7915_CHIP_MT7916
	depends on MTK_MT7915_WIFI_DRIVER
	depends on MTK_MT_MT7915_AP_SUPPORT
	default n

config MTK_MT7915_MEMORY_SHRINK
	bool "Memory Shrink"
	depends on MTK_MT7915_WIFI_DRIVER && MTK_MT7915_CHIP_MT7626
	default n
	
config MTK_MT7915_RPS_EFFICIENCY
	bool "RPS Efficiency"
	depends on MTK_MT7915_WIFI_DRIVER && MTK_MT7915_CHIP_MT7626
	default n

#config MTK_MT7915_BLOCK_NET_IF
#	bool "NETIF Block"
#	depends on MTK_MT7915_WIFI_DRIVER
#	depends on MTK_MT7915_MT_AP_SUPPORT
#	default n
#	help
#	Support Net interface block while Tx-Sw queue full

#config MTK_MT7915_RATE_ADAPTION
#	bool "New Rate Adaptation support"
#	depends on MTK_MT7915_WIFI_DRIVER
#	default y

#config MTK_MT7915_NEW_RATE_ADAPT_SUPPORT
#	bool "Intelligent Rate Adaption"
#	depends on MTK_MT7915_WIFI_DRIVER && MTK_MT7915_RATE_ADAPTION
#	default y

#config MTK_MT7915_AGS_SUPPORT
#	bool "Adaptive Group Switching"
#	depends on MTK_MT7915_WIFI_DRIVER && MTK_MT7915_RATE_ADAPTION
#	depends on MTK_MT7915_MT_AP_SUPPORT || MTK_MT7915_MT_STA_SUPPORT
#	default n

#config MTK_MT7915_RATE_ADAPT_AGBS_SUPPORT
#	bool "Adaptive AGBS Mode"
#	depends on MTK_MT7915_WIFI_DRIVER && MTK_MT7915_RATE_ADAPTION
#	depends on MTK_MT7915_MT_AP_SUPPORT || MTK_MT7915_MT_STA_SUPPORT
#	default y

#config MTK_MT7915_IDS_SUPPORT
#	bool "IDS (Intrusion Detection System) Support"
#	depends on MTK_MT7915_WIFI_DRIVER
#	depends on MTK_MT7915_MT_AP_SUPPORT
#	default n

#config MTK_MT7915_WIFI_WORK_QUEUE
#	bool "Work Queue"
#	depends on MTK_MT7915_WIFI_DRIVER
#	default n

#config MTK_MT7915_WIFI_SKB_RECYCLE
#	bool "SKB Recycle(Linux)"
#	depends on MTK_MT7915_WIFI_DRIVER
#	depends on MTK_MT7915_MT_AP_SUPPORT
#	default n

config MTK_MT7915_RTMP_FLASH_SUPPORT
	bool "Flash Support"
	depends on MTK_MT7915_WIFI_DRIVER
	default y

config MTK_MT7915_PRE_CAL_TRX_SET1_SUPPORT
	bool "Calibration To Flash/BinFile Support"
	depends on MTK_MT7915_WIFI_DRIVER
	default y

config MTK_MT7915_RLM_CAL_CACHE_SUPPORT
	bool "RlmCalibrationCache Support"
	depends on MTK_MT7915_WIFI_DRIVER
	default y

config MTK_MT7915_PRE_CAL_TRX_SET2_SUPPORT
	bool "Pre-calibration to Flash Support"
	depends on MTK_MT7915_WIFI_DRIVER
	default y

config MTK_MT7915_CAL_BIN_FILE_SUPPORT
	bool "Calibration to BinFile Support"
	depends on MTK_MT7915_WIFI_DRIVER
	default y

config MTK_MT7915_RF_LOCKDOWN_SUPPORT
	bool "RF Lockdown Support"
	depends on MTK_MT7915_WIFI_DRIVER
	default n	

config MTK_MT7915_LINK_TEST_SUPPORT
	bool "Link Test Support"
	depends on MTK_MT7915_WIFI_DRIVER
	default n

#config MTK_MT7915_LED_CONTROL_SUPPORT
#	bool "LED Support"
#	depends on MTK_MT7915_WIFI_DRIVER
#	depends on MTK_MT7915_MT_AP_SUPPORT
#	default n

config MTK_MT7915_ATE_SUPPORT
	bool "ATE/QA Support"
	depends on MTK_MT7915_WIFI_DRIVER
	default y

config MTK_MT7915_WLAN_SERVICE
        bool "Wlan Service Library Support"
        depends on MTK_MT7915_WIFI_DRIVER
        default n

#config MTK_MT7915_MEMORY_OPTIMIZATION
#	bool "Memory Optimization"
#	depends on MTK_MT7915_WIFI_DRIVER
#	default n

config MTK_MT7915_PASSPOINT_R2
	bool "Passpoint Release-2 Support"
	depends on MTK_MT7915_WIFI_DRIVER
	select MTK_MT7915_DOT11W_PMF_SUPPORT
	depends on MTK_MT7915_MT_AP_SUPPORT
	default n

config MTK_MT7915_MBO_SUPPORT
        bool "MBO Support"
        depends on MTK_MT7915_WIFI_DRIVER
        select MTK_MT7915_INTERWORKING
        select MTK_MT7915_WNM_SUPPORT
        select MTK_MT7915_DOT11K_RRM_SUPPORT
        select MTK_MT7915_DOT11R_FT_SUPPORT
        select MTK_MT7915_DOT11W_PMF_SUPPORT
        default n

config MTK_MT7915_OCE_SUPPORT
	bool "Optimized Connectivity Experience Support"
	depends on MTK_MT7915_MT_AP_SUPPORT
	depends on MTK_MT7915_MBO_SUPPORT
	depends on MTK_MT7915_CHIP_MT7915 || MTK_MT7915_CHIP_MT7916
	default y

config MTK_MT7915_WTBL_TDD_SUPPORT
	bool "S/W WTBL TDD SWAP Support"
        depends on MTK_MT7915_WIFI_DRIVER
	depends on MTK_MT7915_MT_AP_SUPPORT
	depends on MTK_MT7915_CHIP_MT7915 || MTK_MT7915_CHIP_MT7916
	default n

config MTK_MT7915_MAP_SUPPORT
        bool "MAP Support"
        depends on MTK_MT7915_WIFI_DRIVER
        select MTK_MT7915_INTERWORKING
        select MTK_MT7915_WNM_SUPPORT
        select MTK_MT7915_DOT11K_RRM_SUPPORT
        select MTK_MT7915_DOT11R_FT_SUPPORT
        select MTK_MT7915_DOT11W_PMF_SUPPORT
        default n

config MTK_MT7915_MAP_R2_VER_SUPPORT
        bool "Multi-AP R2 version support"
        depends on MTK_MT7915_MAP_SUPPORT
        default n


config MTK_MT7915_AX8400_COMPATIBLE_SUPPORT
        bool "Multi-AP 6G compitible"
        depends on MTK_MT7915_MAP_SUPPORT
        default n

#config MTK_MT7915_TRACE_TCP_PKT
#	   bool "TCP DATA/ACK packets trace log"
#	   depends on MTK_MT7915_WIFI_DRIVER
#	   default n

config MTK_MT7915_UAPSD
	bool "UAPSD support"
	depends on MTK_MT7915_WIFI_DRIVER
	depends on MTK_MT_AP_SUPPORT || MTK_MT_STA_SUPPORT
	default y

config MTK_MT7915_DPP_SUPPORT
        bool "DPP Support"
        depends on MTK_MT7915_WIFI_DRIVER
        depends on MTK_MT7915_MT_AP_SUPPORT
        select MTK_MT7915_DOT11W_PMF_SUPPORT
        default n

config MTK_MT7915_TCP_RACK_SUPPORT
	bool "TCP Reduced ACK  support"
	depends on MTK_MT7915_WIFI_DRIVER
	default n

#### PA_LNA_Type choice

config MTK_MT7915_RED_SUPPORT
        bool "RED(Random Early Drop) support"
	depends on MTK_MT7915_WIFI_DRIVER
	depends on MTK_MT7915_MT_AP_SUPPORT || MTK_MT7915_MT_STA_SUPPORT
        default y

config MTK_MT7915_FQ_SCH_SUPPORT
        bool "Fair Queueing support"
        depends on MTK_MT7915_WIFI_DRIVER
        depends on MTK_MT7915_MT_AP_SUPPORT && MTK_MT7915_VOW_SUPPORT
        depends on MTK_CHIP_MT7622
        default y

config MTK_MT7915_CTXD_MEM_CPY_SUPPORT
	bool "CTXD(sw mode) support"
	depends on MTK_MT7915_WIFI_DRIVER
	default n

config MTK_MT7915_CTXD_SCATTER_AND_GATHER_SUPPORT
        bool "CTXD(hw mode) support"
        depends on MTK_MT7915_WIFI_DRIVER
        default n

config MTK_MT7915_FDB_SUPPORT
       bool "FW Debug Port"
       depends on MTK_MT7915_WIFI_DRIVER
       default n

choice
        prompt "PA LNA Type of 1st Card"
		depends on ! MTK_MT7915_FIRST_IF_NONE
		
		config MTK_MT7915_FIRST_IF_EPAELNA
		bool "ePAeLNA"
		config MTK_MT7915_FIRST_IF_IPAILNA
		bool "iPAiLNA"		
		config MTK_MT7915_FIRST_IF_IPAELNA
		bool "iPAeLNA"
#		config MTK_MT7915_FIRST_IF_EPAILNA
#		bool "ePAiLNA"
endchoice
choice
        prompt "PA LNA Type of 2nd Card"
		depends on ! MTK_MT7915_SECOND_IF_NONE
		
		config MTK_MT7915_SECOND_IF_EPAELNA
		bool "ePAeLNA"
		config MTK_MT7915_SECOND_IF_IPAILNA
		bool "iPAiLNA"		
		config MTK_MT7915_SECOND_IF_IPAELNA
		bool "iPAeLNA"
#		config MTK_MT7915_SECOND_IF_EPAILNA
#		bool "ePAiLNA"
endchoice
choice
        prompt "PA LNA Type of 3rd Card"
		depends on ! MTK_MT7915_THIRD_IF_NONE
		
		config MTK_MT7915_THIRD_IF_EPAELNA
		bool "ePAeLNA"
		config MTK_MT7915_THIRD_IF_IPAILNA
		bool "iPAiLNA"		
		config MTK_MT7915_THIRD_IF_IPAELNA
		bool "iPAeLNA"
#		config MTK_MT7915_THIRD_IF_EPAILNA
#		bool "ePAiLNA"
endchoice
#### PA_LNA_Type choice END 

config MTK_MT7915_WIFI_FW_BIN_LOAD
       depends on MTK_MT7915_CHIP_MT7916
       bool "load wifi fw with bin file"
       default n

#
# Section for chip architectures
#
# "RLT MAC Support"
config MTK_MT7915_RLT_MAC
	bool
	depends on MTK_MT7915_WIFI_DRIVER
	default n

config MTK_MT7915_RLT_BBP
	bool

config MTK_MT7915_RLT_RF
	bool

# "RTMP MAC Support"
config MTK_MT7915_RTMP_MAC
	bool
	depends on MTK_MT7915_WIFI_DRIVER
	default n

config MTK_MT7915_RTMP_BBP
	bool

config MTK_MT7915_RTMP_RF
	bool

#
# Section for interfaces
#
config MTK_MT7915_RTMP_PCI_SUPPORT
	bool

config MTK_MT7915_RTMP_USB_SUPPORT
	bool

config MTK_MT7915_RTMP_RBUS_SUPPORT
	bool

endmenu

menu "WiFi Operation Modes"
choice
	prompt "Main Mode"
	default MTK_MT7915_WIFI_MODE_AP

	config MTK_MT7915_WIFI_MODE_AP
		tristate "AP"
		select MTK_MT7915_MT_AP_SUPPORT

	config MTK_MT7915_WIFI_MODE_STA
		tristate "STA"
		select MTK_MT7915_MT_STA_SUPPORT

	config MTK_MT7915_WIFI_MODE_BOTH
		tristate "APSTA"
		select MTK_MT7915_MT_AP_SUPPORT
		select MTK_MT7915_MT_STA_SUPPORT
endchoice


config MTK_MT7915_MT_AP_SUPPORT
	tristate "Ralink RT2860 802.11n AP support"
#	depends on NET_RADIO
	select MTK_MT7915_WIRELESS_EXT
	select MTK_MT7915_WEXT_SPY
	select MTK_MT7915_WEXT_PRIV

config MTK_MT7915_WDS_SUPPORT
	bool "WDS"
	depends on MTK_MT7915_MT_AP_SUPPORT
	default y

config MTK_MT7915_MBSS_SUPPORT
	bool "MBSSID"
	depends on MTK_MT7915_MT_AP_SUPPORT
	default y

#config MTK_MT7915_NEW_MBSSID_MODE
#	bool "New MBSSID MODE"
#	depends on MTK_MT7915_MT_AP_SUPPORT && MTK_MT7915_MBSS_SUPPORT
#	depends on MTK_MT7915_RALINK_RT3883 || MTK_MT7915_RALINK_RT3352 || MTK_MT7915_RALINK_RT5350 || MTK_MT7915_RALINK_RT6352 || MTK_MT7915_RALINK_MT7620
#	default y

#config MTK_MT7915_ENHANCE_NEW_MBSSID_MODE
#	bool "Enhanced MBSSID mode"
#	depends on MTK_MT7915_NEW_MBSSID_MODE
#	default y

config MTK_MT7915_APCLI_SUPPORT
	bool "AP-Client Support"
	depends on MTK_MT7915_MT_AP_SUPPORT
	default y

config MTK_MT7915_APCLI_CERT_SUPPORT
	bool "AP-Client TGn Cert Support"
	depends on MTK_MT7915_MT_AP_SUPPORT
	depends on MTK_MT7915_APCLI_SUPPORT
        default n

config MTK_MT7915_MAC_REPEATER_SUPPORT
	bool "MAC Repeater Support"
	depends on MTK_MT7915_MT_AP_SUPPORT
	depends on MTK_MT7915_APCLI_SUPPORT
	depends on MTK_MT7915_RALINK_RT6352 || MTK_MT7915_RALINK_MT7620 || MTK_MT7915_RALINK_MT7603E || MTK_MT7915_MT_AP_SUPPORT
	default y

config MTK_MT7915_APCLI_CONNECTION_TRIAL
        bool "Trial Connection"
        depends on MTK_MT7915_MT_AP_SUPPORT
        depends on MTK_MT7915_APCLI_SUPPORT
        default n

config MTK_MT7915_MWDS
    bool "Mixed WDS(MWDS)"
    depends on MTK_MT7915_MT_AP_SUPPORT
    select MTK_MT7915_APCLI_SUPPORT
    default n

config MTK_MT7915_WIFI_SYSDVT
    bool "Wifi System DVT tool Support"
    depends on MTK_MT7915_MT_AP_SUPPORT
    default n

config MTK_MT7915_WIFI_DBG_TXCMD
        bool "Wifi dbg_txcmd framework"
        depends on MTK_MT7915_WIFI_DRIVER
        depends on MTK_MT7915_MT_MAC
        default y

config MTK_MT7915_MUMIMO_SUPPORT
        bool "MU-MIMO Support"
        depends on MTK_MT7915_WIFI_DRIVER
        select MTK_MT7915_MU_RA_SUPPORT
        default y

config  MTK_MT7915_MUMIMO_PLATFORM_PERFORMANCE_LEVEL
        int "MU-MIMO Platform Performance Level. Suggest 1 for MT7621 and 2 for MT7622"
        depends on MTK_MT7915_MUMIMO_SUPPORT
        default 1 if TARGET_ramips_mt7621
        default 2 if TARGET_mediatek_mt7622
        default 1

config MTK_MT7915_MU_RA_SUPPORT
  	bool "MU-RGA Support"
  	depends on MTK_MT7915_MUMIMO_SUPPORT

config MTK_MT7915_DOT11R_FT_SUPPORT
	bool "802.11r Fast BSS Transition"
	depends on MTK_MT7915_MT_AP_SUPPORT
	default n

config MTK_MT7915_DOT11K_RRM_SUPPORT
	bool "802.11k Radio Resource Management"
	depends on MTK_MT7915_MT_AP_SUPPORT
	default n

config MTK_MT7915_ENTERPRISE_AP_SUPPORT
	bool "Enterprise AP Support"
	depends on MTK_MT7915_MT_AP_SUPPORT
	default n

config MTK_MT7915_MLME_MULTI_QUEUE_SUPPORT
	bool "Mlme MultiQueue Support"
	depends on MTK_MT7915_MT_AP_SUPPORT
	default n

config MTK_MT7915_DYNAMIC_WMM_SUPPORT
	bool "Dynamic WMM Feature"
	depends on MTK_MT7915_WIFI_DRIVER
	depends on MTK_MT7915_MT_AP_SUPPORT
	default n

config MTK_MT7915_WIFI_EAP_FEATURE
	bool "EAP Feature"
	depends on MTK_MT7915_WIFI_DRIVER
	depends on MTK_MT7915_MT_AP_SUPPORT
	default n

#VLAN
config MTK_MT7915_VLAN_SUPPORT
	bool "VLAN Support"
	depends on MTK_MT7915_WIFI_EAP_FEATURE
	default n

#TxRx Statistic
config MTK_MT7915_TXRX_STAT_SUPPORT
	bool "TxRx Stats Support"
	depends on MTK_MT7915_WIFI_EAP_FEATURE
	default n

#Sniffer
config MTK_MT7915_SNIFFER_SUPPORT
	bool "SNIFFER"
	depends on MTK_MT7915_WIFI_EAP_FEATURE
	default n

#Antenna control
config MTK_MT7915_ANTENNA_CONTROL_SUPPORT
	bool "Antenna Control"
	depends on MTK_MT7915_WIFI_EAP_FEATURE
	default n

#Mgmt Tx Power
config MTK_MT7915_MGMT_TXPWR_CTRL
	bool "Mgmt TxPower Control"
	depends on MTK_MT7915_WIFI_EAP_FEATURE
	default n

#RA_PHY_RATE
config MTK_MT7915_RA_PHY_RATE_SUPPORT
	bool "RA PHY RATE Support"
	depends on MTK_MT7915_WIFI_EAP_FEATURE
	default n

#AMPDU Config
config MTK_MT7915_AMPDU_CONF_SUPPORT
	bool "AMPDU Config retry & agglimitSupport"
	depends on MTK_MT7915_WIFI_EAP_FEATURE
	default n

#ACK CTS Timeout
config MTK_MT7915_ACK_CTS_TIMEOUT_SUPPORT
	bool "ACK CTS Timeout cck & ofdm Support"
	depends on MTK_MT7915_WIFI_EAP_FEATURE
	default n

config MTK_MT7915_RADIUS_MAC_AUTH_SUPPORT
    bool "RADIUS MAC Auth Support"
    depends on MTK_MT7915_ENTERPRISE_AP_SUPPORT
    depends on MTK_MT7915_CFG80211_SUPPORT
    default n

config MTK_MT7915_DYNAMIC_VLAN_SUPPORT
	bool "Dynamic VLAN Support"
	depends on MTK_MT7915_MT_AP_SUPPORT
	depends on MTK_MT7915_ENTERPRISE_AP_SUPPORT
	default n

config MTK_MT7915_CFG80211_SUPPORT
	bool "CFG80211"
	depends on MTK_MT7915_MT_AP_SUPPORT
	default n

#CUSTOMISED HOSTAPD
config MTK_MT7915_CUSTOMISED_HOSTAPD_SUPPORT
	bool "Customised Hostapd Support"
	depends on MTK_MT7915_MT_AP_SUPPORT
	depends on MTK_MT7915_CFG80211_SUPPORT
	default n

# HOSTAPD WPA3
config MTK_MT7915_HOSTAPD_WPA3_SUPPORT
        bool "Hostapd WPA3 Support"
        depends on MTK_MT7915_MT_AP_SUPPORT
        depends on MTK_MT7915_CFG80211_SUPPORT
        default n

#HOSTAPD_WPA3R3_SUPPORT
config MTK_MT7915_HOSTAPD_WPA3R3_SUPPORT
		bool "Hostapd WPA3R3 Support"
		depends on MTK_MT7915_HOSTAPD_WPA3_SUPPORT
		default n

#APCLI STA
config MTK_MT7915_APCLI_STA_SUPPORT
	bool "APCLI Supplicant Support"
	depends on MTK_MT7915_APCLI_SUPPORT
	depends on MTK_MT7915_CFG80211_SUPPORT
	default n

#WDS STA
config MTK_MT7915_WDS_STA_SUPPORT
	bool "WDS STA Support"
	depends on MTK_MT7915_APCLI_SUPPORT
	depends on MTK_MT7915_CFG80211_SUPPORT
	default n

#WDS AP
config MTK_MT7915_MBSS_AS_WDS_AP_SUPPORT
	bool "MBSS AS WDS AP Support"
	depends on MTK_MT7915_MT_AP_SUPPORT
	depends on MTK_MT7915_MBSS_SUPPORT
	default n

config MTK_MT7915_QOS_R1_SUPPORT
        bool "MTK QoS R1 support"
        default n

config MTK_MT7915_DSCP_QOS_MAP_SUPPORT
	bool "Dscp Qos Mapping Support"
	depends on MTK_MT7915_MT_AP_SUPPORT
	default n

config MTK_MT7915_DSCP_PRI_SUPPORT
	bool "Dscp Priority Mapping Support"
	depends on MTK_MT7915_MT_AP_SUPPORT
	default n

config MTK_MT7915_MIN_PHY_RATE_SUPPORT
        bool "Minimum PHY rate support"
        depends on MTK_MT7915_MT_AP_SUPPORT
        default n

config MTK_MT7915_FAST_UP_RATE_SUPPORT
        bool "Fast UP rate support"
        depends on MTK_MT7915_MT_AP_SUPPORT
        default n

config MTK_MT7915_CON_WPS_SUPPORT
	bool "Concurrent WPS Support"
	depends on MTK_MT7915_MT_AP_SUPPORT
	depends on MTK_MT7915_APCLI_SUPPORT
	depends on MTK_MT7915_WSC_INCLUDED
	depends on MTK_MT7915_WSC_V2_SUPPORT
#	depends on MTK_MT7915_MULTI_INF_SUPPORT
	default n

#config MTK_MT7915_LLTD_SUPPORT
#	bool "LLTD (Link Layer Topology Discovery Protocol)"
#	depends on MTK_MT7915_MT_AP_SUPPORT

#config MTK_MT7915_COC_SUPPORT
#	bool "CoC Support"
#	depends on MTK_MT7915_MT_AP_SUPPORT
#	default n

#config MTK_MT7915_RT2860V2_SNMP
#	bool "Net-SNMP Support"
#	depends on MTK_MT7915_MT_AP_SUPPORT

config MTK_MT7915_MCAST_RATE_SPECIFIC
	bool "User specific tx rate of mcast pkt"
	depends on MTK_MT7915_MT_AP_SUPPORT
	default y

#config MTK_MT7915_EXT_BUILD_CHANNEL_LIST
#	bool "Extension Channel List"
#	depends on MTK_MT7915_MT_AP_SUPPORT

#config MTK_MT7915_AUTO_CH_SELECT_ENHANCE
#	bool "Auto Channel Selection Enhancement"
#	depends on MTK_MT7915_MT_AP_SUPPORT

config MTK_MT7915_VOW_SUPPORT
	bool "MediaAir(VOW) support"
	depends on MTK_MT7915_MT_AP_SUPPORT
	default y

config MTK_MT7915_DBG_ENHANCE
	bool "DBG ENHANCE"
	default n

#config MTK_MT7915_AIRPLAY_SUPPORT
#	bool "AIRPLAY Support"
#	depends on MTK_MT7915_MT_AP_SUPPORT
#	default n

config MTK_MT7915_BAND_STEERING
	bool "Band Steering"
	depends on MTK_MT7915_MT_AP_SUPPORT
	default y

config MTK_MT7915_LED_CONTROL_SUPPORT
	bool "LED Control Support"
	default n

config MTK_MT7915_WLAN_HOOK
       bool "WLAN hook Support"
       depends on MTK_MT7915_WIFI_DRIVER
       default n

config MTK_MT7915_RADIUS_ACCOUNTING_SUPPORT
	bool "Radius Accounting Support"
	depends on MTK_MT7915_MT_AP_SUPPORT
	default n

config MTK_MT7915_GREENAP_SUPPORT
	bool "GreenAP Support"
	depends on MTK_MT7915_MT_AP_SUPPORT
	default y

config MTK_MT7915_VENDOR_FEATURE11_SUPPORT
        bool "Vendor11 Feature Enable"
        depends on MTK_MT7915_WIFI_DRIVER
        depends on MTK_MT7915_MT_AP_SUPPORT
        default n

config MTK_MT7915_CUSTOMER_VENDOR_IE_SUPPORT
        bool "CUSTOMER VIE Feature Enable"
        depends on MTK_MT7915_WIFI_DRIVER
        depends on MTK_MT7915_MT_AP_SUPPORT
        default n

config MTK_MT7915_PCIE_ASPM_DYM_CTRL_SUPPORT
	bool "Pcie Aspm Dynamic Control Support"
	depends on MTK_MT7915_MT_AP_SUPPORT
	default y

config MTK_MT7915_COEX_SUPPORT
	bool "Coex Support"
	depends on MTK_MT7915_MT_AP_SUPPORT
	default n

config MTK_MT7915_EASY_SETUP_SUPPORT
	bool "Whole Home Coverage - Easy Setup"
	depends on MTK_MT7915_MT_AP_SUPPORT
	default n   

config MTK_MT7915_EVENT_NOTIFIER_SUPPORT
	bool "Whole Home Coverage - Event Notifier"
	depends on MTK_MT7915_MT_AP_SUPPORT
	default n

config MTK_MT7915_AIR_MONITOR
        bool "Air Monitor"
        depends on MTK_MT7915_MT_AP_SUPPORT
        default n

config MTK_MT7915_WNM_SUPPORT
        bool "802.11v WNM Support"
        depends on MTK_MT7915_MT_AP_SUPPORT
        default n

config MTK_MT7915_INTERWORKING
        bool "802.11u Interworking"
        depends on MTK_MT7915_MT_AP_SUPPORT
        default n

#config ROAMING_MT7915_ENHANCE_SUPPORT
#	bool "Roaming Enhance Support"
#	depends on MTK_MT7915_MT_AP_SUPPORT
#	depends on MTK_MT7915_APCLI_SUPPORT
#	default n

config MTK_MT7915_LINUX_NET_TXQ_SUPPORT
	bool "NET TX Queue Support"
	default n

config MTK_MT7915_HWIFI_SUPPORT
	bool "hardware wifi abstraction layer support"
	default n
	help
	  Turn on this feature wifi upper layer (Config/MLME) driver can link to external hal driver 

#config MTK_MT7915_WIFI_FWD_SUPPORT
#        bool "WiFi Forwarding Support"
#        default n

config  MTK_MT7915_WPA3_SUPPORT
        bool "WPA3 Support"
        depends on MTK_MT7915_MT_AP_SUPPORT
        default n

config  MTK_MT7915_OWE_SUPPORT
        bool "Enhanced Open Support"
        depends on MTK_MT7915_MT_AP_SUPPORT
        default n

config  MTK_MT7915_SINGLE_SKU
        bool "Single SKU Support"
        depends on MTK_MT7915_MT_AP_SUPPORT
        default y

config MTK_MT7915_PROFILING_SUPPORT
        bool "WIFI Profiling Support"
        default n

config MTK_MT7915_6G_SUPPORT
        bool "WIFI 6G Support"
        default n
	help
	  Supporting 6GHz Wi-Fi

config MTK_MT7915_BSSMGR_CROSS_MODULE_SUPPORT
        bool "WIFI 6G BSS Manager Cross Module Support"
        depends on MTK_MT7915_6G_SUPPORT
        default n
        help
          Supporting 6GHz Wi-Fi BSS Manager Cross Module

config MTK_MT7915_MT7976_SUPPORT
        bool "MT7976 Support"
        depends on MTK_MT7915_6G_SUPPORT
        default n
	help
	  Supporting A-Die MT7976 confiuration

endmenu

endif

config MTK_MT7915_WIFI_MT_MAC
	bool
	default y
	depends on MTK_MT7915_MT_WIFI

if MTK_MT7915_WIFI_RLT_MAC
	config MTK_MT7915_RLT_MAC
	bool
	default y
endif

if MTK_MT7915_WIFI_RTMP_MAC
	config MTK_MT7915_RTMP_MAC
		bool
		default y
endif

if MTK_MT7915_WIFI_MT_MAC
	config MTK_MT7915_MT_MAC
		bool
		default y

	config MTK_MT7915_CHIP_MT7603E
		bool
		default n

	config MTK_MT7915_CHIP_MT7615E
		bool
		default n

	config MTK_MT7915_CHIP_MT7622
		bool
		default n

	config MTK_MT7915_CHIP_MT7663E
		bool
		default n

	config MTK_MT7915_CHIP_MT7626
		bool
		default n
	config MTK_MT7915_CHIP_AXE
		bool
		default n
	config MTK_MT7915_CHIP_MT7915
		bool
		default n
	config MTK_MT7915_CHIP_MT7916
		bool
		default n
endif

if MTK_MT7915_CHIP_MT7615E || MTK_MT7915_CHIP_MT7622 || MTK_MT7915_CHIP_MT7626 || MTK_MT7915_CHIP_AXE || MTK_MT7915_CHIP_MT7915 || MTK_MT7915_CHIP_MT7916
	config MTK_MT7915_MT_MAC
		bool
		default y
		select MTK_MT7915_RATE_ADAPTION
		select MTK_MT7915_RATE_ADAPT_AGBS_SUPPORT
		select MTK_MT7915_DOT11_N_SUPPORT
		select MTK_MT7915_DOT11_VHT_AC
		select MTK_MT7915_HDR_TRANS_TX_SUPPORT
		select MTK_MT7915_HDR_TRANS_RX_SUPPORT
endif

endif #MTK_MT7915_WIFI_DRIVER#
endif #PACKAGE_kmod-mt7915#
```
